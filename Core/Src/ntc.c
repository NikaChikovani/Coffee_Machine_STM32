/* Private includes ----------------------------------------------------------*/
#include "ntc.h"

/* Private Varibles ----------------------------------------------------------*/
const uint16_t NTC_Lookup_Table[210]={
3974,  // -40C
3967,
3961,
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44,
42 // 169C
};

/* External Varibles ---------------------------------------------------------*/
extern ADC_HandleTypeDef NTC_ADC;

/* Private function prototypes -----------------------------------------------*/
static uint16_t  Get_NTC_ADC(void);

/* function Definition -------------------------------------------------------*/

static uint16_t Get_NTC_ADC(void)
{
	uint16_t ADC_Val = 0;
	uint32_t sum = 0;
	uint8_t Sample_Cnt = 0;
	
	HAL_ADC_Start(&NTC_ADC);
	
		for(uint8_t i=0; i<10; i++)  
			{
				if(HAL_ADC_PollForConversion(&NTC_ADC,1) == HAL_OK)
					{
						sum += HAL_ADC_GetValue(&NTC_ADC);
						Sample_Cnt++;
					}
			}
	if(Sample_Cnt > 0)ADC_Val = (uint16_t)(sum/Sample_Cnt);
	
	return ADC_Val;
	
}

int16_t Get_NTC_Temp(void)
{
	int16_t  Temp = 0;
	uint16_t ADC_Val = 0;
	int16_t Temp_Index = 0;
	
	ADC_Val = Get_NTC_ADC();
	
	while( (ADC_Val < NTC_Lookup_Table[Temp_Index]) && (Temp_Index < 210) )
	{
		Temp_Index++;
	}
	
	Temp = Temp_Index - 40;
	
	return Temp;
}
